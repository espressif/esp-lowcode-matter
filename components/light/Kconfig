## components/light/Kconfig
```kconfig
menu "Light"
    choice LIGHT_DEVICE_TYPE
        prompt "Select light device type"
        default USE_LIGHT_DEVICE_TYPE_WS2812

        config USE_LIGHT_DEVICE_TYPE_WS2812
        bool "Select WS2812 as light device"

        config USE_LIGHT_DEVICE_TYPE_LED
        bool "Select LED as light device"

        config USE_LIGHT_DEVICE_TYPE_BP5758
        bool "Select BP5758 as light device"
    endchoice
endmenu
```
